## main/Kconfig.projbuild
```kconfig
menu "esp32-cam Configuration"

        config WIFI_SSID
        string "wifi default ssid"
        default ""
        help
            wifi default ssid

        config WIFI_PASSWORD
        string "wifi default password"
        default ""
        help
            wifi default password

        config BLE_PROV_PREFIX
        string "ble provision wifi service prefix"
        default "esp32-cam"

        config BLE_PROV_PROOF_POSSESSION
        string "proof of possession pin"
        default "abcd1234"


        config WIFI_PROV_BUTTON_GPIO
        int "gpio pin"
        default 0
        help
            long push this key enter wifi provisioning mode.


        config WIFI_PROV_BUTTON_ACTIVE_LEVEL
        int "push level"
        default 0
        help
            long push enter wifi provisioning mode.

endmenu
```

## sdkconfig.defaults
```kconfig
CONFIG_IDF_TARGET="esp32s3"
CONFIG_FREERTOS_SMP=y
CONFIG_ESP_DEFAULT_CPU_FREQ_MHZ_240=y
CONFIG_ESPTOOLPY_FLASHSIZE_16MB=y
CONFIG_PARTITION_TABLE_SINGLE_APP_LARGE=y
CONFIG_SPIRAM=y
CONFIG_SPIRAM_SPEED_80M=y
CONFIG_SPIRAM_MODE_OCT=y
CONFIG_CAMERA_PSRAM_DMA=y
CONFIG_SPIRAM_TRY_ALLOCATE_WIFI_LWIP=y
CONFIG_LWIP_WND_SCALE=y
CONFIG_TCP_SND_BUF_DEFAULT=65535
CONFIG_BT_ENABLED=y
CONFIG_BT_BLE_ENABLED=y
CONFIG_BT_BLUEDROID_ENABLED=y
CONFIG_BT_BLE_42_FEATURES_SUPPORTED=y
#CONFIG_WIFI_SSID=""
#CONFIG_WIFI_PASSWORD=""
#CONFIG_BLE_PROV_PREFIX="esp32-cam"
#CONFIG_BLE_PROV_PROOF_POSSESSION="abcd1234"
#CONFIG_WIFI_PROV_BUTTON_GPIO=0
#CONFIG_WIFI_PROV_BUTTON_ACTIVE_LEVEL=0
```
